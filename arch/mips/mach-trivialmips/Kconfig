## arch/mips/mach-trivialmips/Kconfig
```kconfig
menu "TrivialMIPS platforms"
    depends on MACH_TRIVIALMIPS

choice
    prompt "Board select"

config TARGET_TRIVIALMIPS_NSCSCC
    bool "NSCSCC board 2019"

endchoice

source "board/nscscc/Kconfig"

endmenu
```
